## Config.in
```kconfig
menu "Kernel"

source "$BR2_EXTERNAL_SVEYRET_PATH/linux/Config.ext.in"

endmenu

menu "Target packages"

source "$BR2_EXTERNAL_SVEYRET_PATH/package/duniter/Config.in"
source "$BR2_EXTERNAL_SVEYRET_PATH/package/gecogvidanto/Config.in"
source "$BR2_EXTERNAL_SVEYRET_PATH/package/incron/Config.in"
source "$BR2_EXTERNAL_SVEYRET_PATH/package/init-rootfs-rotate/Config.in"
source "$BR2_EXTERNAL_SVEYRET_PATH/package/nullmailer/Config.in"
source "$BR2_EXTERNAL_SVEYRET_PATH/package/pam-krb5/Config.in"

endmenu
```

## package/duniter/Config.in
```kconfig
comment "duniter needs nodejs"
	depends on BR2_PACKAGE_HOST_RUSTC_TARGET_ARCH_SUPPORTS
	depends on !BR2_PACKAGE_NODEJS

config BR2_PACKAGE_DUNITER
	bool "duniter"
	depends on BR2_PACKAGE_HOST_RUSTC_TARGET_ARCH_SUPPORTS
	depends on BR2_PACKAGE_NODEJS
	select BR2_PACKAGE_HOST_RUSTC
	help
	  Crypto-currency software to manage libre currency. This
	  package currently only installs the server.

	  https://duniter.org/

if BR2_PACKAGE_DUNITER

config BR2_PACKAGE_DUNITER_GUI
	bool "GUI"
	default y
	help
	  Select this if you want to install the GUI.

endif
```

## package/gecogvidanto/Config.in
```kconfig
comment "gecogvidanto needs nodejs"
	depends on !BR2_PACKAGE_NODEJS

config BR2_PACKAGE_GECOGVIDANTO
	bool "gecogvidanto"
	depends on BR2_PACKAGE_NODEJS
	help
	  A tool to help game masters of the Ğeconomicus game.

	  https://git.duniter.org/gecogvidanto/gecogvidanto

if BR2_PACKAGE_GECOGVIDANTO

comment "Additional systems"

config BR2_PACKAGE_GECOGVIDANTO_BARTER
	bool "Barter"
	help
	  Adds the ability to play sets with barter economic system.

config BR2_PACKAGE_GECOGVIDANTO_MUTCREDIT
	bool "Mutual credit"
	help
	  Adds the ability to play sets with mutual credit economic system.

comment "Additional locales"

config BR2_PACKAGE_GECOGVIDANTO_LOCALE_EO
	bool "Esperanto"
	help
	  Adds the esperanto language to the server.

config BR2_PACKAGE_GECOGVIDANTO_LOCALE_FR
	bool "French"
	help
	  Adds the french language to the server.

endif
```

## package/incron/Config.in
```kconfig
config BR2_PACKAGE_INCRON
	bool "incron"
	depends on BR2_PACKAGE_NODEJS
	help
	  Cron-like daemon which handles filesystem events.

	  https://github.com/ar-/incron
```

## package/nullmailer/Config.in
```kconfig
config BR2_PACKAGE_NULLMAILER
	bool "nullmailer"
	help
	  Simple relay-only mail transport agent.

	  http://untroubled.org/nullmailer/
```

## package/pam-krb5/Config.in
```kconfig
config BR2_PACKAGE_PAM_KRB5
	bool "pam-krb5"
	select BR2_PACKAGE_LIBKRB5
	select BR2_PACKAGE_LINUX_PAM
	help
	  Kerberos V PAM Authentication Module.

	  https://www.eyrie.org/~eagle/software/pam-krb5/
```
